## meta-kiss/conf/machine/dogbonedarker.conf
```bitbake
# Machine configuration for the Dogbone Darker product.
#
# This is a fictitious product, identical to the Dogbone Dark
# (Beaglebone Black) but configured to use out-of-source kernel and
# U-Boot defconfigs and device trees shipped from this layer.
#
# Inherit everything from dogbonedark and override only what differs,
# so the deltas introduced by this machine are easy to read.
require conf/machine/dogbonedark.conf

# Use the device tree shipped by meta-kiss (see linux-kiss.inc),
# copied into the kernel source tree at do_configure time.
KERNEL_DEVICETREE = "ti/omap/am335x-dogbonedarker.dtb"

# This board's hardware is a real BeagleBone Black, so U-Boot's board
# code reads the EEPROM and sets fdtfile=am335x-boneblack.dtb. That
# would make the default extlinux FDTDIR lookup pull the wrong dtb.
# Pin the FDT path explicitly to our shipped device tree instead.
UBOOT_EXTLINUX_FDT = "../am335x-dogbonedarker.dtb"

# Use the defconfig and device tree shipped by meta-kiss (see
# u-boot-kiss_git.bb), dropped into the U-Boot tree at do_configure
# time.
UBOOT_MACHINE = "dogbonedarker_defconfig"
UBOOT_MAKE_TARGET = " DEVICE_TREE=am335x-dogbonedarker"
```

## meta-kiss/conf/machine/stompgoose.conf
```bitbake
# Machine configuration for the Stomp Goose product.
#
# This is a fictitious product, identical to the Stomp Duck
# (STM32MP157A-DK1) but configured to use out-of-source kernel and
# U-Boot defconfigs and device trees shipped from this layer.
#
# Inherit everything from stompduck and override only what differs,
# so the deltas introduced by this machine are easy to read.
require conf/machine/stompduck.conf

# Use the device tree shipped by meta-kiss (see linux-kiss.inc),
# dropped into the kernel source tree at unpack time.
KERNEL_DEVICETREE = "st/stm32mp157a-stompgoose.dtb"

# Use the defconfig and device tree shipped by meta-kiss (see
# u-boot-kiss_git.bb), dropped into the U-Boot tree at unpack time.
UBOOT_MACHINE = "stompgoose_defconfig"
# stompduck appends DEVICE_TREE=st/stm32mp157a-dk1; appending our value
# again lets make's last-assignment-wins rule pick ours at build time.
UBOOT_MAKE_TARGET:append = " DEVICE_TREE=st/stm32mp157a-stompgoose"

# Use the TF-A device tree shipped out-of-source from this layer (see
# trusted-firmware-a bbappend). DTB_FILE_NAME drives both the FDT
# selection and the final image name (tf-a-<basename>.stm32). The
# append below relies on make's last-assignment-wins rule to override
# the DTB_FILE_NAME that stompduck.conf already appended.
TFA_INSTALL_TARGET = "fip tf-a-stm32mp157a-stompgoose.stm32"
EXTRA_OEMAKE:append:pn-trusted-firmware-a = " DTB_FILE_NAME=stm32mp157a-stompgoose.dtb"

# plat-stm32mp1/conf.mk picks several CFG flags by name-matching the
# DTS against built-in flavorlists (no_cryp / MP15-HUK-DT / 512M). Our
# out-of-source stm32mp157a-stompgoose.dts is not in any of those
# lists, so we must restate the same answers explicitly:
#   - CFG_STM32_CRYP=n            (157A SoC has no CRYP block)
#   - CFG_STM32MP15_HUK=y / CFG_STM32_HUK_FROM_DT=y (HUK OTP node lives in our DTS)
#   - CFG_TZDRAM_START / CFG_DRAM_SIZE for a 512 MB part
# PLATFORM_FLAVOR=157A_DK1 and CFG_STM32MP1_OPTEE_IN_SYSRAM=y are
# already appended by stompduck.conf and apply unchanged here.
EXTRA_OEMAKE:append:pn-optee-os = " \
    CFG_EMBED_DTB_SOURCE_FILE=stm32mp157a-stompgoose.dts \
    CFG_STM32_CRYP=n \
    CFG_STM32MP15_HUK=y \
    CFG_STM32_HUK_FROM_DT=y \
    CFG_TZDRAM_START=0xde000000 \
    CFG_DRAM_SIZE=0x20000000 \
"
```
