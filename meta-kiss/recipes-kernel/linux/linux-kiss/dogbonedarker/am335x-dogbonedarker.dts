// SPDX-License-Identifier: GPL-2.0-only
/*
 * Out-of-source device tree for the Dogbone Darker (am335x) board.
 *
 * Functionally a copy of arch/arm/boot/dts/ti/omap/am335x-boneblack.dts
 * shipped from meta-kiss instead of from the upstream kernel tree, with
 * the model string altered so it is easy to verify at runtime (via
 * /proc/device-tree/model or `cat /sys/firmware/devicetree/base/model`)
 * that this DTS is the one in use.
 */
/dts-v1/;

#include "am33xx.dtsi"
#include "am335x-bone-common.dtsi"
#include "am335x-boneblack-common.dtsi"
#include "am335x-boneblack-hdmi.dtsi"

/ {
	model = "KISS Dogbonedarker (out-of-source DTS)";
	compatible = "ti,am335x-bone-black", "ti,am335x-bone", "ti,am33xx";
};

&cpu0_opp_table {
	/*
	 * All PG 2.0 silicon may not support 1GHz but some of the early
	 * BeagleBone Blacks have PG 2.0 silicon which is guaranteed
	 * to support 1GHz OPP so enable it for PG 2.0 on this board.
	 */
	opp-1000000000 {
		/* OPP Nitro */
		opp-supported-hw = <0x06 0x0100>;
	};
};

&baseboard_eeprom {
	vcc-supply = <&ldo4_reg>;
};
