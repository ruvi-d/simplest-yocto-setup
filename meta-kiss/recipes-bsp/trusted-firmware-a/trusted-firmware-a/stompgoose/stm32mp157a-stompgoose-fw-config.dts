// SPDX-License-Identifier: (GPL-2.0+ OR BSD-3-Clause)
/*
 * Out-of-source TF-A FW_CONFIG device tree for the KISS Stompgoose
 * board. Identical to the dk1 fw-config (512 MB DDR), only the file
 * name differs so it lines up with DTB_FILE_NAME=stm32mp157a-stompgoose.dtb.
 */

#define DDR_SIZE	0x20000000 /* 512MB */
#include "stm32mp15-fw-config.dtsi"
